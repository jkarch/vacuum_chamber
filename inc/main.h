/* USER CODE BEGIN Header */
/**
  ******************************************************************************
  * @file           : main.h
  * @brief          : Header for main.c file.
  *                   This file contains the common defines of the application.
  ******************************************************************************
  *  Vacuum Chamber Controller
  *  Created by Joshua Karch for Eyebotix, LLC
  *  (C)2020,2021 by Joshua Karch
  *  This code is partially generated by STM32CubeMX so portions of this code 
  *  that are autogenerated are licensed by ST under Ultimate Liberty license
  *  SLA0044, the "License"; You may not use this file except in compliance with
  *  the License. You may obtain a copy of the License at:
  *                             www.st.com/SLA0044
  *  The remainder of this code is covered under
  *  MIT License
  *  Copyright (c) 2020-2021 Joshua P. Karch 
  *  
  *  Permission is hereby granted, free of charge, to any person obtaining a copy
  *  of this software and associated documentation files (the "Software"), to deal
  *  in the Software without restriction, including without limitation the rights
  *  to use, copy, modify, merge, publish, distribute, sublicense, and/or sell
  *  copies of the Software, and to permit persons to whom the Software is
  *  furnished to do so, subject to the following conditions:
  *  The above copyright notice and this permission notice shall be included in all
  *  copies or substantial portions of the Software.
  *  
  *  THE SOFTWARE IS PROVIDED "AS IS", WITHOUT WARRANTY OF ANY KIND, EXPRESS OR
  *  IMPLIED, INCLUDING BUT NOT LIMITED TO THE WARRANTIES OF MERCHANTABILITY,
  *  FITNESS FOR A PARTICULAR PURPOSE AND NONINFRINGEMENT. IN NO EVENT SHALL THE
  *  AUTHORS OR COPYRIGHT HOLDERS BE LIABLE FOR ANY CLAIM, DAMAGES OR OTHER
  *  LIABILITY, WHETHER IN AN ACTION OF CONTRACT, TORT OR OTHERWISE, ARISING FROM,
  *  OUT OF OR IN CONNECTION WITH THE SOFTWARE OR THE USE OR OTHER DEALINGS IN THE
  *  SOFTWARE.
  *
  ******************************************************************************
  */
/* USER CODE END Header */

/* Define to prevent recursive inclusion -------------------------------------*/
#ifndef __MAIN_H
#define __MAIN_H

#ifdef __cplusplus
extern "C" {
#endif

/* Includes ------------------------------------------------------------------*/
#include "stm32f4xx_hal.h"

/* Private includes ----------------------------------------------------------*/
/* USER CODE BEGIN Includes */

/* USER CODE END Includes */

/* Exported types ------------------------------------------------------------*/
/* USER CODE BEGIN ET */

/* USER CODE END ET */

/* Exported constants --------------------------------------------------------*/
/* USER CODE BEGIN EC */

/* USER CODE END EC */

/* Exported macro ------------------------------------------------------------*/
/* USER CODE BEGIN EM */

/* USER CODE END EM */

/* Exported functions prototypes ---------------------------------------------*/
void Error_Handler(void);

/* USER CODE BEGIN EFP */

/* USER CODE END EFP */

/* Private defines -----------------------------------------------------------*/
#define CS_I2C_SPI_Pin GPIO_PIN_3
#define CS_I2C_SPI_GPIO_Port GPIOE
#define valve_ctrl_Pin GPIO_PIN_5
#define valve_ctrl_GPIO_Port GPIOE
#define pump_ctrl_Pin GPIO_PIN_6
#define pump_ctrl_GPIO_Port GPIOE
#define PC14_OSC32_IN_Pin GPIO_PIN_14
#define PC14_OSC32_IN_GPIO_Port GPIOC
#define PC15_OSC32_OUT_Pin GPIO_PIN_15
#define PC15_OSC32_OUT_GPIO_Port GPIOC
#define PH0_OSC_IN_Pin GPIO_PIN_0
#define PH0_OSC_IN_GPIO_Port GPIOH
#define PH1_OSC_OUT_Pin GPIO_PIN_1
#define PH1_OSC_OUT_GPIO_Port GPIOH
#define OTG_FS_PowerSwitchOn_Pin GPIO_PIN_0
#define OTG_FS_PowerSwitchOn_GPIO_Port GPIOC
#define PDM_OUT_Pin GPIO_PIN_3
#define PDM_OUT_GPIO_Port GPIOC
#define button_Pin GPIO_PIN_2
#define button_GPIO_Port GPIOA
#define button_EXTI_IRQn EXTI2_IRQn
#define I2S3_WS_Pin GPIO_PIN_4
#define I2S3_WS_GPIO_Port GPIOA
#define SPI1_SCK_Pin GPIO_PIN_5
#define SPI1_SCK_GPIO_Port GPIOA
#define SPI1_MISO_Pin GPIO_PIN_6
#define SPI1_MISO_GPIO_Port GPIOA
#define SPI1_MOSI_Pin GPIO_PIN_7
#define SPI1_MOSI_GPIO_Port GPIOA
#define BOOT1_Pin GPIO_PIN_2
#define BOOT1_GPIO_Port GPIOB
#define CLK_IN_Pin GPIO_PIN_10
#define CLK_IN_GPIO_Port GPIOB
#define UNUSED_RX_Pin GPIO_PIN_11
#define UNUSED_RX_GPIO_Port GPIOB
#define LCD_TX_Pin GPIO_PIN_8
#define LCD_TX_GPIO_Port GPIOD
#define LD4_Pin GPIO_PIN_12
#define LD4_GPIO_Port GPIOD
#define LD3_Pin GPIO_PIN_13
#define LD3_GPIO_Port GPIOD
#define LD5_Pin GPIO_PIN_14
#define LD5_GPIO_Port GPIOD
#define LD6_Pin GPIO_PIN_15
#define LD6_GPIO_Port GPIOD
#define press_reset_Pin GPIO_PIN_6
#define press_reset_GPIO_Port GPIOC
#define VBUS_FS_Pin GPIO_PIN_9
#define VBUS_FS_GPIO_Port GPIOA
#define OTG_FS_ID_Pin GPIO_PIN_10
#define OTG_FS_ID_GPIO_Port GPIOA
#define OTG_FS_DM_Pin GPIO_PIN_11
#define OTG_FS_DM_GPIO_Port GPIOA
#define OTG_FS_DP_Pin GPIO_PIN_12
#define OTG_FS_DP_GPIO_Port GPIOA
#define SWDIO_Pin GPIO_PIN_13
#define SWDIO_GPIO_Port GPIOA
#define SWCLK_Pin GPIO_PIN_14
#define SWCLK_GPIO_Port GPIOA
#define I2S3_SCK_Pin GPIO_PIN_10
#define I2S3_SCK_GPIO_Port GPIOC
#define I2S3_SD_Pin GPIO_PIN_12
#define I2S3_SD_GPIO_Port GPIOC
#define press_samp_Pin GPIO_PIN_0
#define press_samp_GPIO_Port GPIOD
#define press_samp_EXTI_IRQn EXTI0_IRQn
#define Audio_RST_Pin GPIO_PIN_4
#define Audio_RST_GPIO_Port GPIOD
#define OTG_FS_OverCurrent_Pin GPIO_PIN_5
#define OTG_FS_OverCurrent_GPIO_Port GPIOD
#define SWO_Pin GPIO_PIN_3
#define SWO_GPIO_Port GPIOB
#define Audio_SCL_Pin GPIO_PIN_6
#define Audio_SCL_GPIO_Port GPIOB
#define Audio_SDA_Pin GPIO_PIN_9
#define Audio_SDA_GPIO_Port GPIOB
/* USER CODE BEGIN Private defines */
//LCD display:
#define LCDCMD 0xFE
#define SETPOS 0x45
	
	
#define BUTTON_IS_RELEASED 0
#define BUTTON_IS_PRESSED 1
#define STABLE_LEVEL_COUNTER 8 //multiples of 10msec
#define RELOAD_THE_COUNTER STABLE_LEVEL_COUNTER
#define USER_BUTTON_DEBOUNCE_STEP__MSEC 10 //10msec task wait time
#define USER_BUTTON_DETECTED 0x2020
	static const uint16_t press_addr = 0x30;
	static uint8_t request_sample[3] = { 0xAA, 0x00, 0x00 };
#define PRESSURE_MASK 0x00FFFFFF
#define OUTPUT_MAX 0xE66666
#define OUTPUT_MIN 0x19999A
#define PRESS_MIN 0.0
#define PRESS_MAX 25.0
#define PRESS_TIMER_DELAY 100	
#define JOY_TIMER_TIMEOUT 3
	
#define UP_RIGHT_THRESHOLD 3064
#define DOWN_LEFT_THRESHOLD 1024
#define MAX_PRESSURE_SETPOINT 20.0
#define DEFAULT_PRESSURE_SETPOINT 14.7  // deflated
#define MIN_PRESSURE_SETPOINT 5.0
#define OFF_HYSTERESIS 1.0
#define PURGE_HYSTERESIS 1.5
	typedef struct
	{
		uint32_t value;
		uint32_t flag_debouncing;
		uint32_t debounce_ctr;
		
	}button_debounce_t;
	
	typedef struct
	{
		uint32_t id;
		uint32_t pressure_raw;
		uint32_t x_posn;
		uint32_t y_posn;
		
	}control_packet_t;
	typedef enum
	{
		pressure_sample = 0x01,
		analog_sample  = 0x02,
		button_pressed = 0x04,
	}sensor_signals_t;
	typedef enum
	{
		SetPressure = 0xAA,
		Purge = 0x55,
		RunContinuous =0xFF,
	}control_commands_t;
	
	typedef struct
	{
		float measured_pressure;
		float current_pressure_setpoint;
		float desired_pressure_setpoint;
		uint32_t desired_command;
		uint32_t current_command;
		uint32_t pump_cmd;
		uint32_t valve_cmd;
	}control_variables_t;
/* USER CODE END Private defines */

#ifdef __cplusplus
}
#endif

#endif /* __MAIN_H */

/************************ (C) COPYRIGHT STMicroelectronics *****END OF FILE****/
